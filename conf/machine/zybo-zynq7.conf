## conf/machine/zybo-zynq7.conf
```bitbake
#@TYPE: Machine
#@NAME: zybo-zynq7
#@DESCRIPTION: Machine support for Zybo. (http://www.digilentinc.com/)
#

PREFERRED_PROVIDER_virtual/kernel_zybo-zynq7 ?= "linux-yocto"
PREFERRED_VERSION_linux-yocto ?= "3.19%"
PREFERRED_VERSION_u-boot-xlnx ?= "v2015.01%"

require conf/machine/include/tune-zynq.inc
require conf/machine/include/machine-xilinx-default.inc
require conf/machine/include/machine-xilinx-board.inc

# ZYBO machine definition known by Xilinx UBOOT
UBOOT_MACHINE = "zynq_zybo_config"
UBOOT_LOADADDRESS = "0x00000000"
UBOOT_ENTRYPOINT = "${UBOOT_LOADADDRESS}"

SERIAL_CONSOLE = "115200 ttyPS0"

MACHINE_DEVICETREE := " \
		zybo/zynq-zybo.dts \
		"

IMAGE_BOOT_FILES += "boot.bin uEnv.txt ${MACHINE}.dtb"
# MACHINE_DEVICETREE = "${S}/arch/arm/boot/dts/zynq-zybo.dts"
# MACHINE_DEVICETREE_append_zynq += " \
# 		common/zynq7-base.dtsi \
# KERNEL_DEVICETREE = "${S}/arch/arm/boot/dts/zynq-zybo.dts"
MY_DTS = "${S}/arch/arm/boot/dts/zynq-zybo.dts"
```
